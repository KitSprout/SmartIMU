/*====================================================================================================*/
/*====================================================================================================*/
#include "stm32f4_system.h"
/*====================================================================================================*/
/*====================================================================================================*/
#define LED   PCO(13)

void GPIO_Config( void );
void Other_Config( void );
/*====================================================================================================*/
/*====================================================================================================*/
int main( void )
{
  SystemInit();
  GPIO_Config();

  /* Systick Setup */
  if(SysTick_Config((u32)(SystemCoreClock/(float)1000)))  // 1kHz
    while(1);

  while(1) {
    
  }
}
/*====================================================================================================*/
/*====================================================================================================*/
void GPIO_Config( void )
{
  GPIO_InitTypeDef GPIO_InitStruct;

  /* LED Clk Init *************************************************************/
  RCC_AHB1PeriphClockCmd(RCC_AHB1Periph_GPIOC, ENABLE);

  /* LED PC13 */
  GPIO_InitStruct.GPIO_Pin = GPIO_Pin_13;
  GPIO_InitStruct.GPIO_Mode = GPIO_Mode_OUT;
  GPIO_InitStruct.GPIO_OType = GPIO_OType_PP;
  GPIO_InitStruct.GPIO_Speed = GPIO_Speed_50MHz;
  GPIO_InitStruct.GPIO_PuPd = GPIO_PuPd_NOPULL;
  GPIO_Init(GPIOC, &GPIO_InitStruct);

  LED = 0;
}
/*====================================================================================================*/
/*====================================================================================================*/
void SysTick_Handler( void )
{
  LED = !LED; // 500Hz Pulse
}
/*====================================================================================================*/
/*====================================================================================================*/
